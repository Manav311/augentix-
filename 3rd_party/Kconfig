## 3rd_party/Kconfig
```kconfig
menu "3rd_party"

config APP_TUYA_SERVICE
	bool "tuya_service"

config APP_TUYA_IPC_SDK_PATH
	string "Tuya IPC SDK path"
	default "/path/to/tuya_ipc_sdk"
	depends on APP_TUYA_SERVICE
	help
	  Path to where the Tuya IPC SDK is installed.

config APP_TUTK_SERVICE
	bool "tutk_service"
	default n
	select LIBTZ
	select LIBLPW
	select APP_SNTP
	help
		TUTK service base on TUTK SDK version 4.3.22

config APP_TUTK_SDK_PATH
	string "TUTK SDK path"
	default "/path/to/tutk_sdk"
	depends on APP_TUTK_SERVICE
	help
	  Path to where the TUTK SDK is installed.

config APP_TANGE_CLOUD
	bool "tange cloud"
	default n

choice APP_TANGE_CLOUD_SWITCH_VIDEO_APP
	bool "select a video application"
	depends on APP_TANGE_CLOUD

config TANGE_USE_AV_MAIN2
	bool "tange use av_main2"
	help
		help_av_main2

config TANGE_USE_AGT_MPI_STREAM
	bool "tange use mpi_stream"
	help
		help_mpi_stream

endchoice

config APP_AMAZON_KVS
	bool "Amazon KVS"
	default n
	help
		Amazon Kinesis Video Streams with WebRTC

config APP_SE_TRNG_PROVIDER
	bool "Custom RNG Provider using Secure Element"
	default n
	help
		Enable a custom RNG provider for OpenSSL v3.x that integrates the 
		True Random Number Generator (TRNG) functionality provided by the Secure Element. 
		This provider relies on Secure Element hardware and the libse core library for RNG operations.
		
		Note: Ensure that the Secure Element hardware and libse core library are properly configured and available in your environment.

endmenu
```

## Kconfig
```kconfig
mainmenu "Augentix SDK Application Configuration"

source "library/Kconfig"
source "3rd_party/Kconfig"
source "av_daemon/Kconfig"
source "network_application/Kconfig"
source "sample/Kconfig"
source "setting_mgmt/Kconfig"
source "streaming_server/Kconfig"
source "system_utility/Kconfig"
```

## application/av_daemon/Kconfig
```kconfig
menu "av_daemon"

config APP_AV_MAIN2
	bool "av_main2"
	depends on APP_CENTCTRL
	select LIBAGTX
	select LIBAVFTR
	select LIBTZ
	default y
	help
	It designed to replace 'av_main' to have better performance and less dependency.

config APP_AV_MAIN2_USE_CCSERVER
	bool "av_main2 use ccserver"
	depends on APP_AV_MAIN2
	depends on APP_CENTCTRL
	default y
	help
		use ccserver

config APP_AV_MAIN2_ENABLE_ML
	bool "enable machine learning features"
	depends on APP_AV_MAIN2
	default n
	help
		Enable machine learning features.
		When enabled, you can choose to run ML models either
		on local or remote core, and select specific model type.

choice APP_AV_MAIN2_ML_MODE
    bool "select ml features executing mode"
    depends on APP_AV_MAIN2_ENABLE_ML

config APP_AV_MAIN2_ENABLE_ML_LOCAL
    bool "execute ml features on local core"
    help
        Run machine learning on local core

config APP_AV_MAIN2_ENABLE_ML_REMOTE
    bool "execute ml features on remote core"
    help
        Run machine learning on remote core
endchoice

choice APP_AV_MAIN2_ML_FEATURES
    bool "select ODv5 model type"
    depends on APP_AV_MAIN2_ENABLE_ML
    depends on APP_AV_MAIN2_ENABLE_ML_LOCAL

config APP_AV_MAIN2_ML_OD_PEOPLE_VEHICLE_PET_LOCAL
    bool "object detection v5 (people vehicle pet)"
    help
        Run object detection v5 on local core and detect people, vehicles, and pets.

config APP_AV_MAIN2_ML_OD_LITE_PEOPLE_VEHICLE_PET_LOCAL
    bool "object detection v5 lite (people vehicle pet)"
    help
        Run object detection v5 on local core and detect people, vehicles, and pets.

config APP_AV_MAIN2_ML_OD_LITE_PEOPLE_LOCAL
    bool "object detection v5 lite (people)"
    help
        Run object detection v5 on local core and detect people.
endchoice

choice APP_AV_MAIN2_ML_FEATURES_REMOTE
    bool "select ODv5 model type"
    depends on APP_AV_MAIN2_ENABLE_ML
    depends on APP_AV_MAIN2_ENABLE_ML_REMOTE

config APP_AV_MAIN2_ML_OD_PEOPLE_VEHICLE_PET_REMOTE
    bool "object detection v5 (people vehicle pet)"
    help
        Run object detection v5 on remote core and detect people, vehicles, and pets.

config APP_AV_MAIN2_ML_OD_LITE_PEOPLE_VEHICLE_PET_REMOTE
    bool "object detection v5 lite (people vehicle pet)"
    help
        Run object detection v5 on remote core and detect people, vehicles, and pets.

config APP_AV_MAIN2_ML_OD_LITE_PEOPLE_REMOTE
    bool "object detection v5 lite (people)"
    help
        Run object detection v5 on remote core and detect people.
endchoice

config APP_AV_MAIN2_USE_OD_PEOPLE_VEHICLE_PET
    bool
    default y if APP_AV_MAIN2_ML_OD_PEOPLE_VEHICLE_PET_LOCAL || APP_AV_MAIN2_ML_OD_PEOPLE_VEHICLE_PET_REMOTE
    default n

config APP_AV_MAIN2_USE_OD_LITE_PEOPLE_VEHICLE_PET
    bool
    default y if APP_AV_MAIN2_ML_OD_LITE_PEOPLE_VEHICLE_PET_LOCAL || APP_AV_MAIN2_ML_OD_LITE_PEOPLE_VEHICLE_PET_REMOTE
    default n

config APP_AV_MAIN2_USE_OD_LITE_PEOPLE
    bool
    default y if APP_AV_MAIN2_ML_OD_LITE_PEOPLE_LOCAL || APP_AV_MAIN2_ML_OD_LITE_PEOPLE_REMOTE
    default n

endmenu
```

## application/library/libeaif/Kconfig
```kconfig
config LIBEAIF_REMOTE_DISABLE
	bool "Disable cloud computing mode"
	depends on LIBEAIF
	default y
	help
		Cloud computing mode is not supported by default. Say Y to disable it,
		and save some memory / storage usage.
```

## application/library/libinf/Kconfig
```kconfig
choice
	prompt "neural network inference backend"

	default LIBINF_TFLITE

	config LIBINF_NCNN
		bool "use ncnn"

	config LIBINF_NCNN_COMPACT
		bool "use ncnn compact (only support HD/ ODv5)"

	config LIBINF_NCNN_MINIMAL
		bool "use ncnn minimal (only support HD)"

	config LIBINF_TFLITE
		bool "use tflite"

	config LIBINF_TFLITE_OPTIM
		bool "use tflite slim"

	config LIBINF_MICROLITE
		bool "use microlite"


endchoice

config LIBINF_TFLITE_TOOL
	bool "enable tflite tool"
	depends on LIBINF_TFLITE || LIBINF_TFLITE_OPTIM
	default n

config LIBINF_REMOTE_CORE
	bool "execute inf at remote core"
	depends on LIBINF_MICROLITE
	select LIBAMPC
	default n

config LIBINF_INSTALL_HUMAN_DETECT_MODELS
	bool "install human detection model"
	default y

config LIBINF_INSTALL_FACE_MODELS
	bool "install face model"
	depends on LIBINF_TFLITE || LIBINF_TFLITE_OPTIM || LIBINF_MICROLITE
	default n

config LIBINF_INSTALL_OBJECT_CLASSIFIER_MODELS
	bool "install object classifier model"
	depends on LIBINF_TFLITE || LIBINF_TFLITE_OPTIM || LIBINF_MICROLITE
	default n

config LIBINF_INSTALL_OBJECT_CLASSIFIER_HUMAN_ONLY_MODELS
	bool "install object classifier model (human only)"
	depends on LIBINF_TFLITE || LIBINF_TFLITE_OPTIM || LIBINF_MICROLITE
	default n

config LIBINF_INSTALL_OBJECT_DETECTION_YOLO_MODELS
	bool "install and enable callback based object detecton"
	depends on LIBINF_NCNN
	default n
```

## application/network_application/Kconfig
```kconfig
menu "network_application"

config APP_CONNSEL
	bool "connsel"
	default y

config APP_EAIF_SERVER
	bool "eaif_server"
	depends on APP_AV_MAIN2
	default n

config APP_IP_ASSIGN
	bool "ip_assign"
	default y

config APP_ONVIF_SERVER
	bool "onvif_server"
	depends on APP_AV_MAIN2 && APP_CENTCTRL
	default y

config APP_STAMEN
	bool "stamen"
	default y

source "network_application/unicorn/Kconfig"

config APP_WEBCGI
	bool "webcgi"
	depends on APP_AV_MAIN2 && APP_CENTCTRL
	default y

config APP_SE_AUTH
	depends on APP_WEBCGI
	bool "se_auth"
	help
		use ssecure element to encrypt and store username and password
	default n

config SECURE_WEB_PAGE
	bool "secure web page"
	depends on APP_WEBCGI
	help
		install secure web page assets and configs.
	default n

if APP_WEBCGI

config APP_WEBCGI_DEMO
	bool "Demo apps"
	default n
	help
	  Install demo web apps to the target.

endif

config APP_WIFI
	bool "wifi"
	default y

config APP_WS_DISCOVERY
	bool "ws_discovery"
	default y


endmenu
```

## application/streaming_server/Kconfig
```kconfig
menu "streaming_server"

config APP_LIVE555
	bool "live555"
	select LIBADO
	default y

config APP_RTSP_SERVER_ENABLE_IVA
	bool "RTSP Server enable IVA"
	select LIBAVFTR
	depends on APP_LIVE555
	default y
	help
		When the option is enabled, rtsp server use libavftr API to get vaftr shm to generate SEI.

config APP_FLV_SERVER
	bool "flv_server"
	default y

config APP_SUPPORT_HTTPS
	bool "support https"
	default y
	depends on APP_FLV_SERVER

config APP_WEBSOCKET_AUDIO_PLAYBACK
	bool "support audio playback based on websocket"
	default y
	depends on APP_SUPPORT_HTTPS

endmenu
```

## application/system_utility/Kconfig
```kconfig
menu "system_utility"

config APP_ACCESS_MODE
	bool "access_mode"
	default y

config APP_ALARM_OUT
	bool "alarm_out"
	default y

config APP_APPVERIFY
	bool "appverify"
	default n

config APP_DAY_NIGHT_MODE
	bool "day_night_mode"
	default n

config APP_EVENT_DAEMON
	bool "event_daemon"
	select LIBPWM
	select LIBTZ
	default y

config APP_GPIO_DAEMONS
	bool "gpio_daemons"
	default y

config APP_NRS
	bool "nrs"

config APP_OTP
	bool "otp"

config APP_SNTP
	bool "sntp"
	default y

config APP_SYSUPD_TOOLS
	bool "sysupd_tools"
	default y

if APP_SYSUPD_TOOLS
source "system_utility/sysupd_tools/Kconfig"
endif

config APP_THERMAL_PROTECTION
	bool "thermal_protection"
	default y

config APP_UVC
	bool "uvc"
	default y

config APP_WATCHDOG
	bool "watchdog"
	default y

config APP_SYSTEM_LEVEL_TEST
	bool "system_level_test"
	default n

config APP_REALTIME_DBG
	bool "realtime_dbg"
	default n

endmenu
```

## application/system_utility/sysupd_tools/Kconfig
```kconfig
choice
	prompt "Select sysupd tools type"
	default NORMAL

config APP_SYSUPD_NORMAL_TOOL
	bool "normal"
	default y

config APP_SYSUPD_ANTI_ROLLBACK_SE_TOOL
	bool "anti_rollback_se"
endchoice
```
